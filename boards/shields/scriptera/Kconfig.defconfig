## boards/shields/scriptera/Kconfig.defconfig
```kconfig
# Copyright (c) 2022 The ZMK Contributors
# SPDX-License-Identifier: MIT

if SHIELD_SCRIPTERA_LEFT

config ZMK_KEYBOARD_NAME
    default "scriptera"
config ZMK_SPLIT_ROLE_CENTRAL
    default y
endif

if SHIELD_SCRIPTERA_LEFT || SHIELD_SCRIPTERA_RIGHT
config ZMK_SPLIT
    default y
endif 

if ZMK_DISPLAY
config I2C
    default y
config SSD1306
    default y
endif # ZMK_DISPLAY

if LVGL
config LVGL_VDB_SIZE
    default 64
config LVGL_DPI
    default 148
config LVGL_BITS_PER_PIXEL
    default 1
choice LVGL_COLOR_DEPTH
    default LVGL_COLOR_DEPTH_1
endchoice
endif # LVGL
```

## boards/shields/scriptera/Kconfig.shield
```kconfig
# Copyright (c) 2022 The ZMK Contributors
# SPDX-License-Identifier: MIT

config SHIELD_SCRIPTERA_LEFT
    def_bool $(shields_list_contains,scriptera_left)

config SHIELD_SCRIPTERA_RIGHT
    def_bool $(shields_list_contains,scriptera_right) 
```

## config/west.yml
```yaml
manifest:
  remotes:
    - name: zmkfirmware
      url-base: https://github.com/zmkfirmware
    # Additional modules containing boards/shields/custom code can be listed here as well
    - name: sadekbaroudi
      url-base: https://github.com/sadekbaroudi
    # See https://docs.zephyrproject.org/3.2.0/develop/west/manifest.html#projects
  projects:
    - name: zmk
      remote: zmkfirmware
      revision: main
      import: app/west.yml
    - name: zmk-fingerpunch-controllers
      remote: sadekbaroudi
      revision: main
      import: config/deps.yml
  self:
    path: config
```
