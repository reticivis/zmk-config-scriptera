&spi0 {
    status = "disabled";
    compatible = "nordic,nrf-spim";

    tball1_0: tball1@0 {
        status = "disabled";
        compatible = "pixart,pmw3610";
        reg = <0>;
        spi-max-frequency = <2000000>;
    };
};